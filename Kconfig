## Kconfig
```kconfig
config APP_ENABLE_EDGEOS_DESKTOP
    bool "Enable DshanPI EdgeOS Desktop"
    default n
    depends on SDK_ENABLE_CANMV
    select RTSMART_3RD_PARTY_ALLOW_LVGL_WITH_CANMV if SDK_ENABLE_CANMV
    select RTSMART_3RD_PARTY_ENABLE_LVGL
    select RTSMART_3RD_PARTY_ENABLE_CJSON
    help
        Build DshanPI EdgeOS Desktop and its AI applications for the
        640x480 ST7701 display.
```
